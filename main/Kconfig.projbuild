## main/Kconfig.projbuild
```kconfig
menu "RR P38 K-Line Interface"

config RRP38_KLINE_UART_PORT
    int "UART port used for the K-line"
    range 1 2
    default 1
    help
        UART peripheral driving the K-line transceiver. UART0 is reserved
        for the debug console, so only 1 or 2 are valid.

config RRP38_KLINE_TX_GPIO
    int "K-line TX GPIO (to transceiver TXD/D input)"
    default 17

config RRP38_KLINE_RX_GPIO
    int "K-line RX GPIO (from transceiver RXD/R output)"
    default 16

config RRP38_LLINE_TX_GPIO
    int "L-line TX GPIO (-1 to disable)"
    default -1
    help
        Optional. ISO 9141 traditionally carries the 5-baud address on the
        L-line as well as the K-line. Most ECUs accept K-only initialisation.
        Set to a GPIO number to drive L in parallel with K during slow init.

config RRP38_EN_GPIO
    int "Transceiver enable (EN/CS/SLP) GPIO (-1 if not needed)"
    default -1
    help
        Many LIN transceivers idle in sleep mode and need an enable pin
        driven high before they will do anything. The onsemi NCV7329 is one:
        pin 2 (EN) has an internal pull-down, so without this the part looks
        completely dead.

        The L9637D does not need this - leave at -1.

config RRP38_INIT_DRIVER_GPIO
    int "Bypass driver GPIO for slow/fast init (-1 to disable)"
    default -1
    help
        Workaround for LIN transceivers that implement a TxD dominant
        timeout. The onsemi NCV7329 releases the bus after tTxD_TIMEOUT
        (14/25/46 ms min/typ/max), but a 5-baud init holds the bus dominant
        for 200 ms per bit cell - so the address gets corrupted.

        Set this to a GPIO driving an N-channel MOSFET (2N7002, BSS138)
        with drain on the K-line and source to ground. Init bits are then
        driven through the MOSFET, bypassing the transceiver's timeout,
        while TxD is held recessive. Normal byte traffic still goes through
        the transceiver.

        Logic is active-high: GPIO high turns the MOSFET on and pulls the
        bus dominant.

        Not needed for the L9637D or the NCV7327 (same part as the NCV7329
        but without the timeout).

config RRP38_KLINE_BAUD
    int "K-line baud rate"
    default 10400

config RRP38_ALLOW_TX
    bool "Allow transmitting on the K-line (DANGEROUS)"
    default n
    help
        When disabled the firmware is physically incapable of transmitting:
        all init and send commands are refused at compile time and the build
        is a pure passive listener.

        Enable this ONLY once you understand the risk. Malformed traffic to
        the P38 BeCM is a documented cause of immobiliser lockout requiring
        the EKA code (or a BeCM reflash) to recover the vehicle.

        Even with this enabled, transmission additionally requires the
        runtime 'arm' console command.

config RRP38_ECHO_STRICT
    bool "Abort a write if the K-line echo does not match"
    default y
    help
        The K-line is a single wire, so every byte transmitted is echoed
        back on RX. A mismatch means bus contention or a wiring fault.
        Aborting on mismatch is the safe behaviour.

endmenu
```

## sdkconfig.defaults
```kconfig
CONFIG_IDF_TARGET="esp32c6"
CONFIG_ESP_MAIN_TASK_STACK_SIZE=6144
CONFIG_FREERTOS_HZ=1000
CONFIG_ESP_CONSOLE_USB_SERIAL_JTAG=y
CONFIG_ESP_TASK_WDT_INIT=n
CONFIG_COMPILER_OPTIMIZATION_PERF=y
CONFIG_ESPTOOLPY_FLASHSIZE_4MB=y
CONFIG_RRP38_KLINE_TX_GPIO=18
CONFIG_RRP38_KLINE_RX_GPIO=19
```
